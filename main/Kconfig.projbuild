## main/Kconfig.projbuild
```kconfig
menu "Example Connection Configuration"

    config ESP_WIFI_SSID
        string "WiFi SSID"
        default "myssid"
        help
            SSID of the WiFi network to connect to.

    config ESP_WIFI_PASSWORD
        string "WiFi Password"
        default "mypassword"
        help
            Password of the WiFi network to connect to.

    config ESP_MAXIMUM_RETRY
        int "Maximum retry"
        default 5
        help
            Maximum number of retries to connect to the WiFi network.

endmenu

menu "LED Configuration"

    config LEDC_GPIO_0
        int "LED GPIO Pin 0 (D0)"
        default 0
        help
            GPIO pin number for LED Channel 0 (D0 is typically GPIO 0).

    config LEDC_GPIO_1
        int "LED GPIO Pin 1 (D1)"
        default 1
        help
            GPIO pin number for LED Channel 1 (D1 is typically GPIO 1).

    config LEDC_GPIO_2
        int "LED GPIO Pin 2 (D2)"
        default 2
        help
            GPIO pin number for LED Channel 2 (D2 is typically GPIO 2).

    config LEDC_GPIO_3
        int "LED GPIO Pin 3 (D3)"
        default 3
        help
            GPIO pin number for LED Channel 3 (D3 is typically GPIO 3).

    config LEDC_GPIO_4
        int "LED GPIO Pin 4 (D4)"
        default 4
        help
            GPIO pin number for LED Channel 4 (D4 is typically GPIO 4).

    config LEDC_GPIO_5
        int "LED GPIO Pin 5 (D5)"
        default 5
        help
            GPIO pin number for LED Channel 5 (D5 is typically GPIO 5).

    choice LEDC_OUTPUT_MODE
        prompt "GPIO Output Mode"
        default LEDC_OUTPUT_MODE_PP
        help
            Choose between Push-Pull and Open-Drain mode.
            Push-Pull is standard for 3.3V LEDs.
            Open-Drain requires an external pull-up resistor (e.g. for 5V/12V).

        config LEDC_OUTPUT_MODE_PP
            bool "Push-Pull"
        config LEDC_OUTPUT_MODE_OD
            bool "Open-Drain"
    endchoice

    config LEDC_DRIVE_STRENGTH
        int "GPIO Drive Strength (0-3)"
        range 0 3
        default 3
        help
            Set the drive strength of the GPIO pin.
            0: ~5mA, 1: ~10mA, 2: ~20mA, 3: ~40mA.
            Higher drive strength can help sharpen edges (reduce ramping).

    config LEDC_PWM_FREQ
        int "PWM Frequency (Hz)"
        default 5000
        help
            Frequency of the PWM signal in Hz.
            5000 Hz (5 kHz) is recommended for COB strips.

    config LEDC_PWM_RES
        int "PWM Resolution (bits)"
        range 1 20
        default 13
        help
            Bit depth of the PWM resolution.
            13 bits gives 8192 steps of dimming resolution.

    config LEDC_INVERT_LOGIC
        bool "Invert PWM Logic"
        default n
        help
            Invert the PWM signal logic.
            Useful for optocouplers or active-low LED drivers where
            a 'High' signal from the MCU turns the LED OFF.

endmenu
```

## sdkconfig.defaults
```kconfig
CONFIG_ESP_WIFI_SSID="myssid"
CONFIG_ESP_WIFI_PASSWORD="mypassword"
CONFIG_ESP_MAXIMUM_RETRY=5
CONFIG_LWIP_IP_FORWARD=y
CONFIG_LWIP_IPV4_NAPT=y
```
